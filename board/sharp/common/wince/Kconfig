## board/sharp/common/wince/Kconfig
```kconfig
config SHARP_WINCE
	bool "Boot Sharp's Windows CE from the internal MMC"
	depends on ARCH_MX28
	select BOARD_LATE_INIT
	select CONSOLE_RECORD
	select FAT_WRITE
	help
	  Adds bootsharpce, which reads Sharp's Windows CE image from the
	  internal MMC (read only), patches it in RAM from pwsh2-boot/boot.nkp
	  on the card and starts it.

if SHARP_WINCE

config SHARP_WINCE_BSP_ARGS
	hex "Address of EBOOT's internal boot flag"
	help
	  Word in the BSP arguments that tells CE it was booted from the
	  internal MMC.

config SHARP_WINCE_SLOT_B
	bool "Fall back to the second image slot"
	default y

config SHARP_WINCE_DEBUG_LOG
	bool "Save CE's RAM debug log to the card"

config SHARP_WINCE_BOOTCMD
	string "Boot command"
	default "brainmenu; savelog"
	help
	  Replaces bootcmd. The previous bootcmd is kept as linux_boot.

config SHARP_WINCE_PROFILE
	string "Profile folder on the card"
	default ""
	help
	  brainmenu reads pwsh2-boot/PROFILE/menu.txt before
	  pwsh2-boot/menu.txt.

config SHARP_PANEL_PORTRAIT
	bool "Menu on a portrait LCDIF panel as EBOOT left it"
	help
	  Draws the menu on a 480-column panel that EBOOT left in LCDIF
	  system mode with its splash at 0x40100000, one panel page per
	  landscape column.

config SHARP_PANEL_PAGES
	int "Panel pages"
	depends on SHARP_PANEL_PORTRAIT
	default 800

config SHARP_PANEL_FULL_FRAMES
	bool "Write only full frames"
	depends on SHARP_PANEL_PORTRAIT
	help
	  For panels that corrupt writes to a partial window. Region updates
	  send the whole frame, and progress bar updates are limited to
	  five a second.

config SHARP_KEYBOARD
	bool "Brain I2C keyboard"
	depends on SYS_I2C_MXS
	help
	  Adds brainkey, which waits for Enter, and brain_keyboard_init(),
	  which adds the keyboard as a console input.

config SHARP_KEYBOARD_I2C_BUS
	int "Keyboard I2C bus"
	depends on SHARP_KEYBOARD
	default 1

config SHARP_KEYBOARD_MATRIX
	bool "Brain GPIO matrix keyboard"
	depends on !SHARP_KEYBOARD
	help
	  Adds brainkey and the menu keys for models whose keyboard is a GPIO
	  matrix. The board lists each key's column and row. A key is read by
	  driving its column low and reading its row.

endif
```
