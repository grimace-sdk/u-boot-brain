## board/sharp/common/wince/Kconfig
```kconfig
config SHARP_WINCE
	bool "Boot Sharp's Windows CE from the internal MMC"
	depends on ARCH_MX28
	select BOARD_LATE_INIT
	select CONSOLE_RECORD
	select FAT_WRITE
	help
	  Adds bootsharpce, which reads Sharp's Windows CE image from the
	  internal MMC (read only), patches it in RAM from pwsh2-boot/boot.nkp
	  on the card and starts it.

if SHARP_WINCE

config SHARP_WINCE_BSP_ARGS
	hex "Address of EBOOT's internal boot flag"
	help
	  Word in the BSP arguments that tells CE it was booted from the
	  internal MMC.

config SHARP_WINCE_SLOT_B
	bool "Fall back to the second image slot"
	default y

config SHARP_WINCE_DEBUG_LOG
	bool "Save CE's RAM debug log to the card"

config SHARP_WINCE_BOOTCMD
	string "Boot command"
	default "bootsharpce; savelog; run linux_boot"
	help
	  Replaces bootcmd. The previous bootcmd is kept as linux_boot.

config SHARP_KEYBOARD
	bool "Brain I2C keyboard"
	depends on SYS_I2C_MXS
	help
	  Adds brainkey, which waits for Enter, and brain_keyboard_init(),
	  which adds the keyboard as a console input.

config SHARP_KEYBOARD_I2C_BUS
	int "Keyboard I2C bus"
	depends on SHARP_KEYBOARD
	default 1

config SHARP_KEYBOARD_MATRIX
	bool "Brain GPIO matrix keyboard"
	depends on !SHARP_KEYBOARD
	help
	  Adds brainkey for models whose keyboard is a GPIO matrix. It drives
	  the Enter column low and waits for the Enter row to read low.

config SHARP_KEYBOARD_MATRIX_ENTER_COLUMN
	int "GPIO driven to scan Enter (bank * 32 + pin)"
	depends on SHARP_KEYBOARD_MATRIX

config SHARP_KEYBOARD_MATRIX_ENTER_ROW
	int "GPIO read for Enter (bank * 32 + pin)"
	depends on SHARP_KEYBOARD_MATRIX

endif
```

## configs/pwa7300_ce_defconfig
```kconfig
CONFIG_ARM=y
CONFIG_ARCH_MX28=y
CONFIG_SYS_TEXT_BASE=0x40200000
CONFIG_SPL_GPIO_SUPPORT=y
CONFIG_SPL_LIBCOMMON_SUPPORT=y
CONFIG_SPL_LIBGENERIC_SUPPORT=y
CONFIG_NR_DRAM_BANKS=1
CONFIG_ENV_SIZE=0x4000
CONFIG_SPL_TEXT_BASE=0x00001000
CONFIG_TARGET_PWA7200=y
CONFIG_SHARP_WINCE=y
CONFIG_SHARP_WINCE_BSP_ARGS=0x400F6C60
# CONFIG_SHARP_WINCE_SLOT_B is not set
CONFIG_SHARP_WINCE_DEBUG_LOG=y
CONFIG_SHARP_WINCE_BOOTCMD="teprobe; if brainkey; then bootsharpce stock; else bootsharpce; fi; savelog; run linux_boot"
CONFIG_SHARP_KEYBOARD=y
CONFIG_SHARP_KEYBOARD_I2C_BUS=0
CONFIG_SPL_SERIAL_SUPPORT=y
CONFIG_SPL=y
CONFIG_USE_PREBOOT=y
CONFIG_DEFAULT_FDT_FILE="imx28-pwa7200.dtb"
CONFIG_CONSOLE_RECORD_OUT_SIZE=0x10000
# CONFIG_DISPLAY_BOARDINFO is not set
CONFIG_ARCH_MISC_INIT=y
# CONFIG_SPL_FRAMEWORK is not set
CONFIG_HUSH_PARSER=y
CONFIG_CMD_BOOTZ=y
CONFIG_CMD_GPIO=y
CONFIG_CMD_I2C=y
CONFIG_CMD_MMC=y
CONFIG_CMD_CACHE=y
CONFIG_CMD_EXT4=y
CONFIG_CMD_EXT4_WRITE=y
CONFIG_CMD_FAT=y
CONFIG_CMD_FS_GENERIC=y
CONFIG_ENV_OVERWRITE=y
CONFIG_SYS_RELOC_GD_ENV_ADDR=y
# CONFIG_NET is not set
CONFIG_MXS_GPIO=y
CONFIG_SYS_I2C_MXS=y
CONFIG_MMC_MXS=y
CONFIG_CONS_INDEX=0
CONFIG_OF_LIBFDT=y
```
